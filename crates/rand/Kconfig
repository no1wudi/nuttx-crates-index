## crates/rand/Kconfig
```kconfig
# Copyright (c) 2025 Xiaomi Corporation
# SPDX-License-Identifier: Apache-2.0

config RUST_CRATE_RAND
	tristate "Crate Rand"
	default n

if RUST_CRATE_RAND

config RUST_CRATE_RAND_PRIORITY
	int "Crate Rand task priority"
	default 100

config RUST_CRATE_RAND_STACKSIZE
	int "Crate Rand stack size"
	default DEFAULT_TASK_STACKSIZE

endif
```

## crates/rand_chacha/Kconfig
```kconfig
# Copyright (c) 2025 Xiaomi Corporation
# SPDX-License-Identifier: Apache-2.0

config RUST_CRATE_RAND_CHACHA
	tristate "Crate Rand Chacha"
	default n

if RUST_CRATE_RAND_CHACHA

config RUST_CRATE_RAND_CHACHA_PRIORITY
	int "Crate Rand Chacha task priority"
	default 100

config RUST_CRATE_RAND_CHACHA_STACKSIZE
	int "Crate Rand Chacha stack size"
	default DEFAULT_TASK_STACKSIZE

endif
```

## crates/regex/Kconfig
```kconfig
# Copyright (c) 2025 Xiaomi Corporation
# SPDX-License-Identifier: Apache-2.0

config RUST_CRATE_REGEX
	tristate "Crate Regex"
	default n

if RUST_CRATE_REGEX

config RUST_CRATE_REGEX_PRIORITY
	int "Crate Regex task priority"
	default 100

config RUST_CRATE_REGEX_STACKSIZE
	int "Crate Regex stack size"
	default 24576

endif
```

## crates/regex_lite/Kconfig
```kconfig
# Copyright (c) 2025 Xiaomi Corporation
# SPDX-License-Identifier: Apache-2.0

config RUST_CRATE_REGEX_LITE
	tristate "Crate Regex Lite"
	default n

if RUST_CRATE_REGEX_LITE

config RUST_CRATE_REGEX_LITE_PRIORITY
	int "Crate Regex Lite task priority"
	default 100

config RUST_CRATE_REGEX_LITE_STACKSIZE
	int "Crate Regex Lite stack size"
	default DEFAULT_TASK_STACKSIZE

endif
```

## crates/regex_syntax/Kconfig
```kconfig
# Copyright (c) 2025 Xiaomi Corporation
# SPDX-License-Identifier: Apache-2.0

config RUST_CRATE_REGEX_SYNTAX
	tristate "Crate Regex Syntax"
	default n

if RUST_CRATE_REGEX_SYNTAX

config RUST_CRATE_REGEX_SYNTAX_PRIORITY
	int "Crate Regex Syntax task priority"
	default 100

config RUST_CRATE_REGEX_SYNTAX_STACKSIZE
	int "Crate Regex Syntax stack size"
	default DEFAULT_TASK_STACKSIZE

endif
```

## crates/ryu/Kconfig
```kconfig
# Copyright (c) 2025 Xiaomi Corporation
# SPDX-License-Identifier: Apache-2.0

config RUST_CRATE_RYU
	tristate "\"Crate Ryu\" example"
	default n

if RUST_CRATE_RYU

config RUST_CRATE_RYU_PRIORITY
	int "Ryu task priority"
	default 100

config RUST_CRATE_RYU_STACKSIZE
	int "Ryu stack size"
	default DEFAULT_TASK_STACKSIZE

endif
```

## crates/scopeguard/Kconfig
```kconfig
# Copyright (c) 2025 Xiaomi Corporation
# SPDX-License-Identifier: Apache-2.0

config RUST_CRATE_SCOPEGUARD
	tristate "Crate Scopeguard"
	default n

if RUST_CRATE_SCOPEGUARD

config RUST_CRATE_SCOPEGUARD_PRIORITY
	int "Crate Scopeguard task priority"
	default 100

config RUST_CRATE_SCOPEGUARD_STACKSIZE
	int "Crate Scopeguard stack size"
	default DEFAULT_TASK_STACKSIZE

endif
```

## crates/semver/Kconfig
```kconfig
# Copyright (c) 2025 Xiaomi Corporation
# SPDX-License-Identifier: Apache-2.0

config RUST_CRATE_SEMVER
	tristate "Crate Semver"
	default n

if RUST_CRATE_SEMVER

config RUST_CRATE_SEMVER_PRIORITY
	int "Crate Semver task priority"
	default 100

config RUST_CRATE_SEMVER_STACKSIZE
	int "Crate Semver stack size"
	default DEFAULT_TASK_STACKSIZE

endif
```

## crates/serde_json/Kconfig
```kconfig
# Copyright (c) 2025 Xiaomi Corporation
# SPDX-License-Identifier: Apache-2.0

config RUST_CRATE_SERDE_JSON
	tristate "Crate Serde Json"
	default n

if RUST_CRATE_SERDE_JSON

config RUST_CRATE_SERDE_JSON_PRIORITY
	int "Crate Serde Json task priority"
	default 100

config RUST_CRATE_SERDE_JSON_STACKSIZE
	int "Crate Serde Json stack size"
	default DEFAULT_TASK_STACKSIZE

endif
```

## crates/sha2/Kconfig
```kconfig
# Copyright (c) 2025 Xiaomi Corporation
# SPDX-License-Identifier: Apache-2.0

config RUST_CRATE_SHA2
	tristate "Crate Sha2"
	default n

if RUST_CRATE_SHA2

config RUST_CRATE_SHA2_PRIORITY
	int "Crate Sha2 task priority"
	default 100

config RUST_CRATE_SHA2_STACKSIZE
	int "Crate Sha2 stack size"
	default DEFAULT_TASK_STACKSIZE

endif
```

## crates/smallvec/Kconfig
```kconfig
# Copyright (c) 2025 Xiaomi Corporation
# SPDX-License-Identifier: Apache-2.0

config RUST_CRATE_SMALLVEC
	tristate "Crate Smallvec"
	default n

if RUST_CRATE_SMALLVEC

config RUST_CRATE_SMALLVEC_PRIORITY
	int "Crate Smallvec task priority"
	default 100

config RUST_CRATE_SMALLVEC_STACKSIZE
	int "Crate Smallvec stack size"
	default DEFAULT_TASK_STACKSIZE

endif
```

## crates/std_alloc/Kconfig
```kconfig
# Copyright (c) 2025 Xiaomi Corporation
# SPDX-License-Identifier: Apache-2.0

config RUST_CRATE_STD_ALLOC
	tristate "\"Std Alloc\" example"
	default n

if RUST_CRATE_STD_ALLOC

config RUST_CRATE_STD_ALLOC_PRIORITY
	int "Std Alloc task priority"
	default 100

config RUST_CRATE_STD_ALLOC_STACKSIZE
	int "Std Alloc stack size"
	default DEFAULT_TASK_STACKSIZE

endif
```

## crates/std_any/Kconfig
```kconfig
# Copyright (c) 2025 Xiaomi Corporation
# SPDX-License-Identifier: Apache-2.0

config RUST_CRATE_STD_ANY
	tristate "\"Std Any\" example"
	default n

if RUST_CRATE_STD_ANY

config RUST_CRATE_STD_ANY_PRIORITY
	int "Std Any task priority"
	default 100

config RUST_CRATE_STD_ANY_STACKSIZE
	int "Std Any stack size"
	default DEFAULT_TASK_STACKSIZE

endif
```

## crates/std_ascii/Kconfig
```kconfig
# Copyright (c) 2025 Xiaomi Corporation
# SPDX-License-Identifier: Apache-2.0

config RUST_CRATE_STD_ASCII
	tristate "\"Std ASCII\" example"
	default n

if RUST_CRATE_STD_ASCII

config RUST_CRATE_STD_ASCII_PRIORITY
	int "Std ASCII task priority"
	default 100

config RUST_CRATE_STD_ASCII_STACKSIZE
	int "Std ASCII stack size"
	default DEFAULT_TASK_STACKSIZE

endif
```

## crates/std_barrier/Kconfig
```kconfig
# Copyright (c) 2025 Xiaomi Corporation
# SPDX-License-Identifier: Apache-2.0

config RUST_CRATE_STD_BARRIER
	tristate "\"Std Barrier\" example"
	default n

if RUST_CRATE_STD_BARRIER

config RUST_CRATE_STD_BARRIER_PRIORITY
	int "Std Barrier task priority"
	default 100

config RUST_CRATE_STD_BARRIER_STACKSIZE
	int "Std Barrier stack size"
	default DEFAULT_TASK_STACKSIZE

endif
```

## crates/std_borrow/Kconfig
```kconfig
# Copyright (c) 2025 Xiaomi Corporation
# SPDX-License-Identifier: Apache-2.0

config RUST_CRATE_STD_BORROW
	tristate "\"Std Borrow\" example"
	default n

if RUST_CRATE_STD_BORROW

config RUST_CRATE_STD_BORROW_PRIORITY
	int "Std Borrow task priority"
	default 100

config RUST_CRATE_STD_BORROW_STACKSIZE
	int "Std Borrow stack size"
	default DEFAULT_TASK_STACKSIZE

endif
```

## crates/std_boxed/Kconfig
```kconfig
# Copyright (c) 2025 Xiaomi Corporation
# SPDX-License-Identifier: Apache-2.0

config RUST_CRATE_STD_BOXED
	tristate "\"Std Boxed\" example"
	default n

if RUST_CRATE_STD_BOXED

config RUST_CRATE_STD_BOXED_PRIORITY
	int "Std Boxed task priority"
	default 100

config RUST_CRATE_STD_BOXED_STACKSIZE
	int "Std Boxed stack size"
	default DEFAULT_TASK_STACKSIZE

endif
```

## crates/std_cell/Kconfig
```kconfig
# Copyright (c) 2025 Xiaomi Corporation
# SPDX-License-Identifier: Apache-2.0

config RUST_CRATE_STD_CELL
	tristate "\"Std Cell\" example"
	default n

if RUST_CRATE_STD_CELL

config RUST_CRATE_STD_CELL_PRIORITY
	int "Std Cell task priority"
	default 100

config RUST_CRATE_STD_CELL_STACKSIZE
	int "Std Cell stack size"
	default DEFAULT_TASK_STACKSIZE

endif
```

## crates/std_char/Kconfig
```kconfig
# Copyright (c) 2025 Xiaomi Corporation
# SPDX-License-Identifier: Apache-2.0

config RUST_CRATE_STD_CHAR
	tristate "\"Std Char\" example"
	default n

if RUST_CRATE_STD_CHAR

config RUST_CRATE_STD_CHAR_PRIORITY
	int "Std Char task priority"
	default 100

config RUST_CRATE_STD_CHAR_STACKSIZE
	int "Std Char stack size"
	default DEFAULT_TASK_STACKSIZE

endif
```

## crates/std_clone/Kconfig
```kconfig
# Copyright (c) 2025 Xiaomi Corporation
# SPDX-License-Identifier: Apache-2.0

config RUST_CRATE_STD_CLONE
	tristate "\"Std Clone\" example"
	default n

if RUST_CRATE_STD_CLONE

config RUST_CRATE_STD_CLONE_PRIORITY
	int "Std Clone task priority"
	default 100

config RUST_CRATE_STD_CLONE_STACKSIZE
	int "Std Clone stack size"
	default DEFAULT_TASK_STACKSIZE

endif
```

## crates/std_cmp/Kconfig
```kconfig
# Copyright (c) 2025 Xiaomi Corporation
# SPDX-License-Identifier: Apache-2.0

config RUST_CRATE_STD_CMP
	tristate "\"Std Cmp\" example"
	default n

if RUST_CRATE_STD_CMP

config RUST_CRATE_STD_CMP_PRIORITY
	int "Std Cmp task priority"
	default 100

config RUST_CRATE_STD_CMP_STACKSIZE
	int "Std Cmp stack size"
	default DEFAULT_TASK_STACKSIZE

endif
```

## crates/std_collections/Kconfig
```kconfig
# Copyright (c) 2025 Xiaomi Corporation
# SPDX-License-Identifier: Apache-2.0

config RUST_CRATE_STD_COLLECTIONS
	tristate "\"Std Collections\" example"
	default n

if RUST_CRATE_STD_COLLECTIONS

config RUST_CRATE_STD_COLLECTIONS_PRIORITY
	int "Std Collections task priority"
	default 100

config RUST_CRATE_STD_COLLECTIONS_STACKSIZE
	int "Std Collections stack size"
	default DEFAULT_TASK_STACKSIZE

endif
```

## crates/std_condvar/Kconfig
```kconfig
# Copyright (c) 2025 Xiaomi Corporation
# SPDX-License-Identifier: Apache-2.0

config RUST_CRATE_STD_CONDVAR
	tristate "\"Std Condvar\" example"
	default n

if RUST_CRATE_STD_CONDVAR

config RUST_CRATE_STD_CONDVAR_PRIORITY
	int "Std Condvar task priority"
	default 100

config RUST_CRATE_STD_CONDVAR_STACKSIZE
	int "Std Condvar stack size"
	default 4096

endif
```

## crates/std_fs/Kconfig
```kconfig
# Copyright (c) 2025 Xiaomi Corporation
# SPDX-License-Identifier: Apache-2.0

config RUST_CRATE_STD_FS
	tristate "\"Std FS\" example"
	default n

if RUST_CRATE_STD_FS

config RUST_CRATE_STD_FS_PRIORITY
	int "Std FS task priority"
	default 100

config RUST_CRATE_STD_FS_STACKSIZE
	int "Std FS stack size"
	default DEFAULT_TASK_STACKSIZE

endif
```

## crates/std_future/Kconfig
```kconfig
# Copyright (c) 2025 Xiaomi Corporation
# SPDX-License-Identifier: Apache-2.0

config RUST_CRATE_STD_FUTURE
	tristate "\"Std Future\" example"
	default n

if RUST_CRATE_STD_FUTURE

config RUST_CRATE_STD_FUTURE_PRIORITY
	int "Std Future task priority"
	default 100

config RUST_CRATE_STD_FUTURE_STACKSIZE
	int "Std Future stack size"
	default DEFAULT_TASK_STACKSIZE

endif
```
