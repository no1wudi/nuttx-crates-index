## crates/std_hash/Kconfig
```kconfig
# Copyright (c) 2025 Xiaomi Corporation
# SPDX-License-Identifier: Apache-2.0

config RUST_CRATE_STD_HASH
	tristate "\"Std Hash\" example"
	default n

if RUST_CRATE_STD_HASH

config RUST_CRATE_STD_HASH_PRIORITY
	int "Std Hash task priority"
	default 100

config RUST_CRATE_STD_HASH_STACKSIZE
	int "Std Hash stack size"
	default DEFAULT_TASK_STACKSIZE

endif
```

## crates/std_io/Kconfig
```kconfig
# Copyright (c) 2025 Xiaomi Corporation
# SPDX-License-Identifier: Apache-2.0

config RUST_CRATE_STD_IO
	tristate "\"Std IO\" example"
	default n

if RUST_CRATE_STD_IO

config RUST_CRATE_STD_IO_PRIORITY
	int "Std IO task priority"
	default 100

config RUST_CRATE_STD_IO_STACKSIZE
	int "Std IO stack size"
	default DEFAULT_TASK_STACKSIZE

endif
```

## crates/std_lazylock/Kconfig
```kconfig
# Copyright (c) 2025 Xiaomi Corporation
# SPDX-License-Identifier: Apache-2.0

config RUST_CRATE_STD_LAZYLOCK
	tristate "\"Std LazyLock\" example"
	default n

if RUST_CRATE_STD_LAZYLOCK

config RUST_CRATE_STD_LAZYLOCK_PRIORITY
	int "Std LazyLock task priority"
	default 100

config RUST_CRATE_STD_LAZYLOCK_STACKSIZE
	int "Std LazyLock stack size"
	default DEFAULT_TASK_STACKSIZE

endif
```

## crates/std_mpsc/Kconfig
```kconfig
# Copyright (c) 2025 Xiaomi Corporation
# SPDX-License-Identifier: Apache-2.0

config RUST_CRATE_STD_MPSC
	tristate "\"Std MPSC\" example"
	default n

if RUST_CRATE_STD_MPSC

config RUST_CRATE_STD_MPSC_PRIORITY
	int "Std MPSC task priority"
	default 100

config RUST_CRATE_STD_MPSC_STACKSIZE
	int "Std MPSC stack size"
	default DEFAULT_TASK_STACKSIZE

endif
```

## crates/std_mutex/Kconfig
```kconfig
# Copyright (c) 2025 Xiaomi Corporation
# SPDX-License-Identifier: Apache-2.0

config RUST_CRATE_STD_MUTEX
	tristate "\"Std Mutex\" example"
	default n

if RUST_CRATE_STD_MUTEX

config RUST_CRATE_STD_MUTEX_PRIORITY
	int "Std Mutex task priority"
	default 100

config RUST_CRATE_STD_MUTEX_STACKSIZE
	int "Std Mutex stack size"
	default DEFAULT_TASK_STACKSIZE

endif
```

## crates/std_once/Kconfig
```kconfig
# Copyright (c) 2025 Xiaomi Corporation
# SPDX-License-Identifier: Apache-2.0

config RUST_CRATE_STD_ONCE
	tristate "\"Std Once\" example"
	default n

if RUST_CRATE_STD_ONCE

config RUST_CRATE_STD_ONCE_PRIORITY
	int "Std Once task priority"
	default 100

config RUST_CRATE_STD_ONCE_STACKSIZE
	int "Std Once stack size"
	default DEFAULT_TASK_STACKSIZE

endif
```

## crates/std_path/Kconfig
```kconfig
# Copyright (c) 2025 Xiaomi Corporation
# SPDX-License-Identifier: Apache-2.0

config RUST_CRATE_STD_PATH
	tristate "\"Std Path\" example"
	default n

if RUST_CRATE_STD_PATH

config RUST_CRATE_STD_PATH_PRIORITY
	int "Std Path task priority"
	default 100

config RUST_CRATE_STD_PATH_STACKSIZE
	int "Std Path stack size"
	default DEFAULT_TASK_STACKSIZE

endif
```

## crates/std_pin/Kconfig
```kconfig
# Copyright (c) 2025 Xiaomi Corporation
# SPDX-License-Identifier: Apache-2.0

config RUST_CRATE_STD_PIN
	tristate "\"Std Pin\" example"
	default n

if RUST_CRATE_STD_PIN

config RUST_CRATE_STD_PIN_PRIORITY
	int "Std Pin task priority"
	default 100

config RUST_CRATE_STD_PIN_STACKSIZE
	int "Std Pin stack size"
	default DEFAULT_TASK_STACKSIZE

endif
```

## crates/std_println/Kconfig
```kconfig
# Copyright (c) 2025 Xiaomi Corporation
# SPDX-License-Identifier: Apache-2.0

config RUST_CRATE_STD_PRINTLN
	tristate "\"Std Println\" example"
	default n

if RUST_CRATE_STD_PRINTLN

config RUST_CRATE_STD_PRINTLN_PRIORITY
	int "Std Println task priority"
	default 100

config RUST_CRATE_STD_PRINTLN_STACKSIZE
	int "Std Println stack size"
	default 8192

endif
```

## crates/std_println_minimal/Kconfig
```kconfig
# Copyright (c) 2025 Xiaomi Corporation
# SPDX-License-Identifier: Apache-2.0

config RUST_CRATE_STD_PRINTLN_MINIMAL
	tristate "\"Std Println Minimal\" example"
	default n

if RUST_CRATE_STD_PRINTLN_MINIMAL

config RUST_CRATE_STD_PRINTLN_MINIMAL_PRIORITY
	int "Std Println Minimal task priority"
	default 100

config RUST_CRATE_STD_PRINTLN_MINIMAL_STACKSIZE
	int "Std Println Minimal stack size"
	default DEFAULT_TASK_STACKSIZE

endif
```

## crates/std_rwlock/Kconfig
```kconfig
# Copyright (c) 2025 Xiaomi Corporation
# SPDX-License-Identifier: Apache-2.0

config RUST_CRATE_STD_RWLOCK
	tristate "\"Std RwLock\" example"
	default n

if RUST_CRATE_STD_RWLOCK

config RUST_CRATE_STD_RWLOCK_PRIORITY
	int "Std RwLock task priority"
	default 100

config RUST_CRATE_STD_RWLOCK_STACKSIZE
	int "Std RwLock stack size"
	default DEFAULT_TASK_STACKSIZE

endif
```

## crates/std_thread/Kconfig
```kconfig
# Copyright (c) 2025 Xiaomi Corporation
# SPDX-License-Identifier: Apache-2.0

config RUST_CRATE_STD_THREAD
	tristate "\"Std Thread\" example"
	default n

if RUST_CRATE_STD_THREAD

config RUST_CRATE_STD_THREAD_PRIORITY
	int "Std Thread task priority"
	default 100

config RUST_CRATE_STD_THREAD_STACKSIZE
	int "Std Thread stack size"
	default DEFAULT_TASK_STACKSIZE

endif
```

## crates/std_thread_local/Kconfig
```kconfig
# Copyright (c) 2025 Xiaomi Corporation
# SPDX-License-Identifier: Apache-2.0

config RUST_CRATE_STD_THREAD_LOCAL
	tristate "Std Thread Local"
	default n

if RUST_CRATE_STD_THREAD_LOCAL

config RUST_CRATE_STD_THREAD_LOCAL_PRIORITY
	int "Std Thread Local task priority"
	default 100

config RUST_CRATE_STD_THREAD_LOCAL_STACKSIZE
	int "Std Thread Local stack size"
	default DEFAULT_TASK_STACKSIZE

endif
```

## crates/std_time/Kconfig
```kconfig
# Copyright (c) 2025 Xiaomi Corporation
# SPDX-License-Identifier: Apache-2.0

config RUST_CRATE_STD_TIME
	tristate "\"Std Time\" example"
	default n

if RUST_CRATE_STD_TIME

config RUST_CRATE_STD_TIME_PRIORITY
	int "Std Time task priority"
	default 100

config RUST_CRATE_STD_TIME_STACKSIZE
	int "Std Time stack size"
	default DEFAULT_TASK_STACKSIZE

endif
```

## crates/strsim/Kconfig
```kconfig
# Copyright (c) 2025 Xiaomi Corporation
# SPDX-License-Identifier: Apache-2.0

config RUST_CRATE_STRSIM
	tristate "Crate Strsim"
	default n

if RUST_CRATE_STRSIM

config RUST_CRATE_STRSIM_PRIORITY
	int "Crate Strsim task priority"
	default 100

config RUST_CRATE_STRSIM_STACKSIZE
	int "Crate Strsim stack size"
	default DEFAULT_TASK_STACKSIZE

endif
```

## crates/thiserror/Kconfig
```kconfig
# Copyright (c) 2025 Xiaomi Corporation
# SPDX-License-Identifier: Apache-2.0

config RUST_CRATE_THISERROR
	tristate "\"Crate Thiserror\" example"
	default n

if RUST_CRATE_THISERROR

config RUST_CRATE_THISERROR_PRIORITY
	int "Thiserror task priority"
	default 100

config RUST_CRATE_THISERROR_STACKSIZE
	int "Thiserror stack size"
	default DEFAULT_TASK_STACKSIZE

endif
```

## crates/time/Kconfig
```kconfig
# Copyright (c) 2025 Xiaomi Corporation
# SPDX-License-Identifier: Apache-2.0

config RUST_CRATE_TIME
	tristate "Crate Time"
	default n

if RUST_CRATE_TIME

config RUST_CRATE_TIME_PRIORITY
	int "Crate Time task priority"
	default 100

config RUST_CRATE_TIME_STACKSIZE
	int "Crate Time stack size"
	default DEFAULT_TASK_STACKSIZE

endif
```

## crates/tokio/Kconfig
```kconfig
# Copyright (c) 2025 Xiaomi Corporation
# SPDX-License-Identifier: Apache-2.0

config RUST_CRATE_TOKIO
	tristate "Crate Tokio"
	default n

if RUST_CRATE_TOKIO

config RUST_CRATE_TOKIO_PRIORITY
	int "Crate Tokio task priority"
	default 100

config RUST_CRATE_TOKIO_STACKSIZE
	int "Crate Tokio stack size"
	default DEFAULT_TASK_STACKSIZE

endif
```

## crates/toml/Kconfig
```kconfig
# Copyright (c) 2025 Xiaomi Corporation
# SPDX-License-Identifier: Apache-2.0

config RUST_CRATE_TOML
	tristate "Crate Toml"
	default n

if RUST_CRATE_TOML

config RUST_CRATE_TOML_PRIORITY
	int "Crate Toml task priority"
	default 100

config RUST_CRATE_TOML_STACKSIZE
	int "Crate Toml stack size"
	default 8192

endif
```

## crates/unicode_ident/Kconfig
```kconfig
# Copyright (c) 2025 Xiaomi Corporation
# SPDX-License-Identifier: Apache-2.0

config RUST_CRATE_UNICODE_IDENT
	tristate "Crate Unicode Ident"
	default n

if RUST_CRATE_UNICODE_IDENT

config RUST_CRATE_UNICODE_IDENT_PRIORITY
	int "Crate Unicode Ident task priority"
	default 100

config RUST_CRATE_UNICODE_IDENT_STACKSIZE
	int "Crate Unicode Ident stack size"
	default DEFAULT_TASK_STACKSIZE

endif
```

## crates/version_check/Kconfig
```kconfig
# Copyright (c) 2025 Xiaomi Corporation
# SPDX-License-Identifier: Apache-2.0

config RUST_CRATE_VERSION_CHECK
	tristate "Crate Version Check"
	default n

if RUST_CRATE_VERSION_CHECK

config RUST_CRATE_VERSION_CHECK_PRIORITY
	int "Crate Version Check task priority"
	default 100

config RUST_CRATE_VERSION_CHECK_STACKSIZE
	int "Crate Version Check stack size"
	default DEFAULT_TASK_STACKSIZE

endif
```

## crates/zerocopy/Kconfig
```kconfig
# Copyright (c) 2025 Xiaomi Corporation
# SPDX-License-Identifier: Apache-2.0

config RUST_CRATE_ZEROCOPY
	tristate "Crate Zerocopy"
	default n

if RUST_CRATE_ZEROCOPY

config RUST_CRATE_ZEROCOPY_PRIORITY
	int "Crate Zerocopy task priority"
	default 100

config RUST_CRATE_ZEROCOPY_STACKSIZE
	int "Crate Zerocopy stack size"
	default DEFAULT_TASK_STACKSIZE

endif
```
