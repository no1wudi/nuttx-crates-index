## crates/aho_corasick/Kconfig
```kconfig
# Copyright (c) 2025 Xiaomi Corporation
# SPDX-License-Identifier: Apache-2.0

config RUST_CRATE_AHO_CORASICK
	tristate "Crate Aho-Corasick"
	default n

if RUST_CRATE_AHO_CORASICK

config RUST_CRATE_AHO_CORASICK_PRIORITY
	int "Aho-Corasick task priority"
	default 100

config RUST_CRATE_AHO_CORASICK_STACKSIZE
	int "Aho-Corasick stack size"
	default 8192

endif
```

## crates/autocfg/Kconfig
```kconfig
# Copyright (c) 2025 Xiaomi Corporation
# SPDX-License-Identifier: Apache-2.0

config RUST_CRATE_AUTOCFG
	tristate "Crate Autocfg"
	default n

if RUST_CRATE_AUTOCFG

config RUST_CRATE_AUTOCFG_PRIORITY
	int "Crate Autocfg task priority"
	default 100

config RUST_CRATE_AUTOCFG_STACKSIZE
	int "Crate Autocfg stack size"
	default DEFAULT_TASK_STACKSIZE

endif
```

## crates/base64/Kconfig
```kconfig
# Copyright (c) 2025 Xiaomi Corporation
# SPDX-License-Identifier: Apache-2.0

config RUST_CRATE_BASE64
	tristate "\"Crate Base64\" example"
	default n

if RUST_CRATE_BASE64

config RUST_CRATE_BASE64_PRIORITY
	int "Base64 task priority"
	default 100

config RUST_CRATE_BASE64_STACKSIZE
	int "Base64 stack size"
	default DEFAULT_TASK_STACKSIZE

endif
```

## crates/bitflags/Kconfig
```kconfig
# Copyright (c) 2025 Xiaomi Corporation
# SPDX-License-Identifier: Apache-2.0

config RUST_CRATE_BITFLAGS
	tristate "Crate Bitflags"
	default n

if RUST_CRATE_BITFLAGS

config RUST_CRATE_BITFLAGS_PRIORITY
	int "Crate Bitflags task priority"
	default 100

config RUST_CRATE_BITFLAGS_STACKSIZE
	int "Crate Bitflags stack size"
	default DEFAULT_TASK_STACKSIZE

endif
```

## crates/byteorder/Kconfig
```kconfig
# Copyright (c) 2025 Xiaomi Corporation
# SPDX-License-Identifier: Apache-2.0

config RUST_CRATE_BYTEORDER
	tristate "Crate Byteorder"
	default n

if RUST_CRATE_BYTEORDER

config RUST_CRATE_BYTEORDER_PRIORITY
	int "Crate Byteorder task priority"
	default 100

config RUST_CRATE_BYTEORDER_STACKSIZE
	int "Crate Byteorder stack size"
	default DEFAULT_TASK_STACKSIZE

endif
```

## crates/bytes/Kconfig
```kconfig
# Copyright (c) 2025 Xiaomi Corporation
# SPDX-License-Identifier: Apache-2.0

config RUST_CRATE_BYTES
	tristate "Crate Bytes"
	default n

if RUST_CRATE_BYTES

config RUST_CRATE_BYTES_PRIORITY
	int "Crate Bytes task priority"
	default 100

config RUST_CRATE_BYTES_STACKSIZE
	int "Crate Bytes stack size"
	default DEFAULT_TASK_STACKSIZE

endif
```

## crates/cfg_if/Kconfig
```kconfig
# Copyright (c) 2025 Xiaomi Corporation
# SPDX-License-Identifier: Apache-2.0

config RUST_CRATE_CFG_IF
	tristate "Crate Cfg If"
	default n

if RUST_CRATE_CFG_IF

config RUST_CRATE_CFG_IF_PRIORITY
	int "Crate Cfg If task priority"
	default 100

config RUST_CRATE_CFG_IF_STACKSIZE
	int "Crate Cfg If stack size"
	default DEFAULT_TASK_STACKSIZE

endif
```

## crates/chrono/Kconfig
```kconfig
# Copyright (c) 2025 Xiaomi Corporation
# SPDX-License-Identifier: Apache-2.0

config RUST_CRATE_CHRONO
	tristate "Crate Chrono"
	default n

if RUST_CRATE_CHRONO

config RUST_CRATE_CHRONO_PRIORITY
	int "Crate Chrono task priority"
	default 100

config RUST_CRATE_CHRONO_STACKSIZE
	int "Crate Chrono stack size"
	default DEFAULT_TASK_STACKSIZE

endif
```

## crates/core_println/Kconfig
```kconfig
# Copyright (c) 2025 Xiaomi Corporation
# SPDX-License-Identifier: Apache-2.0

config RUST_CRATE_CORE_PRINTLN
	tristate "Core Println"
	default n

if RUST_CRATE_CORE_PRINTLN

config RUST_CRATE_CORE_PRINTLN_PRIORITY
	int "Core Println task priority"
	default 100

config RUST_CRATE_CORE_PRINTLN_STACKSIZE
	int "Core Println stack size"
	default DEFAULT_TASK_STACKSIZE

endif
```

## crates/core_puts/Kconfig
```kconfig
# Copyright (c) 2025 Xiaomi Corporation
# SPDX-License-Identifier: Apache-2.0

config RUST_CRATE_CORE_PUTS
	tristate "\"Core Puts\" example"
	default n

if RUST_CRATE_CORE_PUTS

config RUST_CRATE_CORE_PUTS_PRIORITY
	int "Core Puts task priority"
	default 100

config RUST_CRATE_CORE_PUTS_STACKSIZE
	int "Core Puts stack size"
	default DEFAULT_TASK_STACKSIZE

endif
```

## crates/equivalent/Kconfig
```kconfig
# Copyright (c) 2025 Xiaomi Corporation
# SPDX-License-Identifier: Apache-2.0

config RUST_CRATE_EQUIVALENT
	tristate "Crate Equivalent"
	default n

if RUST_CRATE_EQUIVALENT

config RUST_CRATE_EQUIVALENT_PRIORITY
	int "Crate Equivalent task priority"
	default 100

config RUST_CRATE_EQUIVALENT_STACKSIZE
	int "Crate Equivalent stack size"
	default DEFAULT_TASK_STACKSIZE

endif
```

## crates/hashbrown/Kconfig
```kconfig
# Copyright (c) 2025 Xiaomi Corporation
# SPDX-License-Identifier: Apache-2.0

config RUST_CRATE_HASHBROWN
	tristate "Crate Hashbrown"
	default n

if RUST_CRATE_HASHBROWN

config RUST_CRATE_HASHBROWN_PRIORITY
	int "Crate Hashbrown task priority"
	default 100

config RUST_CRATE_HASHBROWN_STACKSIZE
	int "Crate Hashbrown stack size"
	default DEFAULT_TASK_STACKSIZE

endif
```

## crates/heck/Kconfig
```kconfig
# Copyright (c) 2025 Xiaomi Corporation
# SPDX-License-Identifier: Apache-2.0

config RUST_CRATE_HECK
	tristate "Crate Heck"
	default n

if RUST_CRATE_HECK

config RUST_CRATE_HECK_PRIORITY
	int "Crate Heck task priority"
	default 100

config RUST_CRATE_HECK_STACKSIZE
	int "Crate Heck stack size"
	default DEFAULT_TASK_STACKSIZE

endif
```

## crates/indexmap/Kconfig
```kconfig
# Copyright (c) 2025 Xiaomi Corporation
# SPDX-License-Identifier: Apache-2.0

config RUST_CRATE_INDEXMAP
	tristate "Crate Indexmap"
	default n

if RUST_CRATE_INDEXMAP

config RUST_CRATE_INDEXMAP_PRIORITY
	int "Crate Indexmap task priority"
	default 100

config RUST_CRATE_INDEXMAP_STACKSIZE
	int "Crate Indexmap stack size"
	default DEFAULT_TASK_STACKSIZE

endif
```

## crates/itertools/Kconfig
```kconfig
# Copyright (c) 2025 Xiaomi Corporation
# SPDX-License-Identifier: Apache-2.0

config RUST_CRATE_ITERTOOLS
	tristate "Crate Itertools"
	default n

if RUST_CRATE_ITERTOOLS

config RUST_CRATE_ITERTOOLS_PRIORITY
	int "Crate Itertools task priority"
	default 100

config RUST_CRATE_ITERTOOLS_STACKSIZE
	int "Crate Itertools stack size"
	default DEFAULT_TASK_STACKSIZE

endif
```

## crates/itoa/Kconfig
```kconfig
# Copyright (c) 2025 Xiaomi Corporation
# SPDX-License-Identifier: Apache-2.0

config RUST_CRATE_ITOA
	tristate "Crate Itoa"
	default n

if RUST_CRATE_ITOA

config RUST_CRATE_ITOA_PRIORITY
	int "Crate Itoa task priority"
	default 100

config RUST_CRATE_ITOA_STACKSIZE
	int "Crate Itoa stack size"
	default DEFAULT_TASK_STACKSIZE

endif
```

## crates/lazy_static/Kconfig
```kconfig
# Copyright (c) 2025 Xiaomi Corporation
# SPDX-License-Identifier: Apache-2.0

config RUST_CRATE_LAZY_STATIC
	tristate "Crate Lazy Static"
	default n

if RUST_CRATE_LAZY_STATIC

config RUST_CRATE_LAZY_STATIC_PRIORITY
	int "Crate Lazy Static task priority"
	default 100

config RUST_CRATE_LAZY_STATIC_STACKSIZE
	int "Crate Lazy Static stack size"
	default DEFAULT_TASK_STACKSIZE

endif
```

## crates/libc/Kconfig
```kconfig
# Copyright (c) 2025 Xiaomi Corporation
# SPDX-License-Identifier: Apache-2.0

config RUST_CRATE_LIBC
	tristate "Crate Libc"
	default n

if RUST_CRATE_LIBC

config RUST_CRATE_LIBC_PRIORITY
	int "Crate Libc task priority"
	default 100

config RUST_CRATE_LIBC_STACKSIZE
	int "Crate Libc stack size"
	default DEFAULT_TASK_STACKSIZE

endif
```

## crates/libc_puts/Kconfig
```kconfig
# Copyright (c) 2025 Xiaomi Corporation
# SPDX-License-Identifier: Apache-2.0

config RUST_CRATE_LIBC_PUTS
	tristate "Crate Libc Puts"
	default n

if RUST_CRATE_LIBC_PUTS

config RUST_CRATE_LIBC_PUTS_PRIORITY
	int "Crate Libc Puts task priority"
	default 100

config RUST_CRATE_LIBC_PUTS_STACKSIZE
	int "Crate Libc Puts stack size"
	default DEFAULT_TASK_STACKSIZE

endif
```

## crates/memchr/Kconfig
```kconfig
# Copyright (c) 2025 Xiaomi Corporation
# SPDX-License-Identifier: Apache-2.0

config RUST_CRATE_MEMCHR
	tristate "Crate Memchr"
	default n

if RUST_CRATE_MEMCHR

config RUST_CRATE_MEMCHR_PRIORITY
	int "Crate Memchr task priority"
	default 100

config RUST_CRATE_MEMCHR_STACKSIZE
	int "Crate Memchr stack size"
	default DEFAULT_TASK_STACKSIZE

endif
```

## crates/miniz_oxide/Kconfig
```kconfig
# Copyright (c) 2025 Xiaomi Corporation
# SPDX-License-Identifier: Apache-2.0

config RUST_CRATE_MINIZ_OXIDE
	tristate "Crate Miniz Oxide"
	default n

if RUST_CRATE_MINIZ_OXIDE

config RUST_CRATE_MINIZ_OXIDE_PRIORITY
	int "Crate Miniz Oxide task priority"
	default 100

config RUST_CRATE_MINIZ_OXIDE_STACKSIZE
	int "Crate Miniz Oxide stack size"
	default DEFAULT_TASK_STACKSIZE

endif
```

## crates/nom/Kconfig
```kconfig
# Copyright (c) 2025 Xiaomi Corporation
# SPDX-License-Identifier: Apache-2.0

config RUST_CRATE_NOM
	tristate "Crate Nom"
	default n

if RUST_CRATE_NOM

config RUST_CRATE_NOM_PRIORITY
	int "Crate Nom task priority"
	default 100

config RUST_CRATE_NOM_STACKSIZE
	int "Crate Nom stack size"
	default DEFAULT_TASK_STACKSIZE

endif
```

## crates/once_cell/Kconfig
```kconfig
# Copyright (c) 2025 Xiaomi Corporation
# SPDX-License-Identifier: Apache-2.0

config RUST_CRATE_ONCE_CELL
	tristate "Crate Once Cell"
	default n

if RUST_CRATE_ONCE_CELL

config RUST_CRATE_ONCE_CELL_PRIORITY
	int "Crate Once Cell task priority"
	default 100

config RUST_CRATE_ONCE_CELL_STACKSIZE
	int "Crate Once Cell stack size"
	default DEFAULT_TASK_STACKSIZE

endif
```

## crates/prost/Kconfig
```kconfig
# Copyright (c) 2025 Xiaomi Corporation
# SPDX-License-Identifier: Apache-2.0

config RUST_CRATE_PROST
	tristate "Crate Prost"
	default n

if RUST_CRATE_PROST

config RUST_CRATE_PROST_PRIORITY
	int "Crate Prost task priority"
	default 100

config RUST_CRATE_PROST_STACKSIZE
	int "Crate Prost stack size"
	default DEFAULT_TASK_STACKSIZE

endif
```

## crates/protobuf/Kconfig
```kconfig
# Copyright (c) 2025 Xiaomi Corporation
# SPDX-License-Identifier: Apache-2.0

config RUST_CRATE_PROTOBUF
	tristate "Crate Protobuf"
	default n
	help
	  Enable this option to build the protobuf crate demonstration application.
	  This application shows basic serialization and deserialization using the protobuf crate.

if RUST_CRATE_PROTOBUF

config RUST_CRATE_PROTOBUF_PRIORITY
	int "Crate Protobuf task priority"
	default 100

config RUST_CRATE_PROTOBUF_STACKSIZE
	int "Crate Protobuf stack size"
	default DEFAULT_TASK_STACKSIZE

endif
```
